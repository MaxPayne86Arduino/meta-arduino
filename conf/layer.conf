## conf/layer.conf
```bitbake
# We might have a conf and classes directory, append to BBPATH
BBPATH .= ":${LAYERDIR}"

# We have a recipes directory, add to BBFILES
BBFILES += "${LAYERDIR}/recipes*/*/*.bb ${LAYERDIR}/recipes*/*/*.bbappend"

BBFILE_COLLECTIONS += "meta-arduino"
BBFILE_PATTERN_meta-arduino := "^${LAYERDIR}/"
BBFILE_PRIORITY_meta-arduino = "9"

#LAYERDEPENDS_meta-arduino = "meta-imx-bsp meta-freescale"
LAYERSERIES_COMPAT_meta-arduino = "kirkstone nanbield"
```

## conf/machine/portenta-x8.conf
```bitbake
#@TYPE: Machine
#@NAME: Arduino Portenta-X8 i.MX8MM
#@SOC: i.MX8MM
#@DESCRIPTION: Machine configuration for Arduino Potenta-X8 (i.MX 8M Mini + STM32H7)
#@MAINTAINER: Arduino <info@arduino.cc>

require conf/machine/imx8mm-lpddr4-evk.conf

MACHINEOVERRIDES .= ":imx8mm-lpddr4-evk"

# Override the variables you want to change here
UBOOT_CONFIG_BASENAME = "portenta-x8"
UBOOT_DTB_NAME = "portenta-x8.dtb"

IMX_DEFAULT_BSP = "nxp"
PREFERRED_PROVIDER:virtual/kernel = "linux-imx_6.6"
#KERNEL_DEFCONFIG = "portenta_x8_defconfig"
KBUILD_DEFCONFIG:portenta-x8 = "portenta_x8_defconfig"
KERNEL_DEVICETREE = ""
KERNEL_DEVICETREE:remove:portenta-x8 = " freescale/imx8mm-evk.dtb"
PREFERRED_PROVIDER:virtual/dtb ?= "arduino-device-tree"

# Include custom device tree for linux kernel
MACHINE_EXTRA_RRECOMMENDS += "arduino-device-tree"

# Add additional firmware, mostly support for Murata 1DX WiFi / Bluetooth solution
MACHINE_FIRMWARE:append = " linux-firmware linux-firmware-cyw-fmac-fw linux-firmware-cyw-fmac-nvram linux-firmware-cyw-bt-patch"

# Added X8H7 solution based on ext. STM32 mcu
MACHINE_FIRMWARE:append = " linux-firmware-arduino-portenta-x8-stm32h7"

# Add custom video bridge and usb typec controller / power delivery solution
MACHINE_EXTRA_RRECOMMENDS += "anx7625"

# Add x8h7 driver for communication with external cortex processor via spi
MACHINE_EXTRA_RRECOMMENDS += "x8h7"

# Add extra kernel modules needed for Max carrier board
MACHINE_EXTRA_RRECOMMENDS += "bq24195 cs42l52"

# Add mipi-csi cmos sensors drivers
MACHINE_EXTRA_RRECOMMENDS += "ov5647-mipi imx219 imx477 imx708"

# Add mipi-dsi panels and touch screen controllers drivers
MACHINE_EXTRA_RRECOMMENDS += "panel-sitronix-st7701 panel-jadard-ek79202d atmel-mxt-ts"

# Add neural external pcie modules drivers
MACHINE_EXTRA_RRECOMMENDS += "google-gasket-driver akida-pcie-driver hailo-pcie-driver"

# Module to load devicetree overlays at runtime in userspace
MACHINE_EXTRA_RRECOMMENDS:append = " dtbocfg"

# Portenta X8 has a Murata 1DX wifi/bt module which uses custom recipes
# linux-firmware-cyw-fmac-fw, linux-firmware-cyw-fmac-nvram and linux-firmware-cyw-bt-patch.
# Make sure we avoid default linux bcm43430 firmware
CORE_IMAGE_BASE_INSTALL:remove:portenta-x8 = " \
    linux-firmware-bcm43430 \
"

KERNEL_MODULE_AUTOLOAD:portenta-x8:append = "anx7625 i2c-dev spidev"

# @TODO: below seems to be ignored
SERIAL_CONSOLES = "115200;ttymxc2"
```

## conf/machine/portenta-x9.conf
```bitbake
#@TYPE: Machine
#@NAME: Arduino Portenta-X9 i.MX93
#@SOC: i.MX8MM
#@DESCRIPTION: Machine configuration for Arduino Potenta-X9 (i.MX93 9x9 + STM32C0)
#@MAINTAINER: Massimiliano Agneni <massimiliano.agneni@iptronix.com>

require conf/machine/imx93-9x9-lpddr4-qsb.conf

MACHINEOVERRIDES .= ":imx93-9x9-lpddr4-qsb"

# Override the variables you want to change here
IMX_DEFAULT_BSP = "nxp"
PREFERRED_PROVIDER:virtual/kernel = "linux-imx_6.6"
#KERNEL_DEFCONFIG = "portenta_x9_defconfig"
KBUILD_DEFCONFIG:portenta-x9 = "portenta_x9_defconfig"
KERNEL_DEVICETREE = ""
KERNEL_DEVICETREE:remove:portenta-x9 = " freescale/imx93-9x9-qsb.dtb"
PREFERRED_PROVIDER:virtual/dtb ?= "arduino-device-tree"

# Include custom device tree for linux kernel
MACHINE_EXTRA_RRECOMMENDS += "arduino-device-tree"

# Add additional out of tree modules
MACHINE_EXTRA_RRECOMMENDS += "kernel-module-nxp-wlan"

SERIAL_CONSOLE = "115200;ttyLP5"
SERIAL_CONSOLES = "115200;ttyLP5"
```

## meta-arduino-bsp/conf/layer.conf
```bitbake
# We might have a conf and classes directory, append to BBPATH
BBPATH .= ":${LAYERDIR}"

# We have a recipes directory, add to BBFILES
BBFILES += "${LAYERDIR}/recipes*/*/*.bb ${LAYERDIR}/recipes*/*/*.bbappend"

BBFILE_COLLECTIONS += "meta-arduino-bsp"
BBFILE_PATTERN_meta-arduino-bsp := "^${LAYERDIR}/"
BBFILE_PRIORITY_meta-arduino-bsp = "9"

LAYERDEPENDS_meta-arduino-bsp = "core freescale-layer fsl-bsp-release fsl-sdk-release"
LAYERSERIES_COMPAT_meta-arduino-bsp = "kirkstone nanbield"
```

## meta-arduino-bsp/conf/machine/imx8mp-astrial.conf
```bitbake
#@TYPE: Machine
#@NAME: System Electronics Astrial
#@SOC: i.MX8MP
#@DESCRIPTION: Machine configuration for System Electronics Astrial i.MX 8M Plus board with LPDDR4
#@MAINTAINER: Arduino <info@arduino.cc>

require conf/machine/imx8mp-lpddr4-evk.conf

MACHINEOVERRIDES .= ":imx8mp-lpddr4-evk"

# Override the variables you want to change here
IMX_DEFAULT_BSP = "nxp"
PREFERRED_PROVIDER:virtual/kernel = "linux-imx_6.6"
KBUILD_DEFCONFIG:imx8mp-astrial = ""
KERNEL_DEVICETREE = ""
KERNEL_DEVICETREE:remove:imx8mp-astrial = " freescale/imx8mp-evk-root.dtb"
PREFERRED_PROVIDER:virtual/dtb ?= "arduino-device-tree"

# Include custom device tree for linux kernel
MACHINE_EXTRA_RRECOMMENDS += "arduino-device-tree"

# Add additional out of tree modules
MACHINE_EXTRA_RRECOMMENDS += "kernel-module-nxp-wlan"

# Firmware NXP IW612 chipset
PREFERRED_RPROVIDER_linux-firmware-nxpiw612-sdio = "firmware-nxp-wifi"
MACHINE_EXTRA_RRECOMMENDS += "firmware-nxp-wifi-nxpiw612-sdio firmware-nxp-wifi"

# Hailo PCIE driver
MACHINE_EXTRA_RRECOMMENDS += "kernel-module-hailo-pcie-driver"

# Additional specific packages
MACHINE_EXTRA_RRECOMMENDS += "lmbench"

# Custom wks file
WKS_FILE:mx8mp-nxp-bsp = "imx-imx-boot-singlepart.wks.in"

# @TODO: below seems to be ignored
SERIAL_CONSOLES = "115200;ttymxc0"
```

## meta-arduino-lmp/conf/layer.conf
```bitbake
# We might have a conf and classes directory, append to BBPATH
BBPATH .= ":${LAYERDIR}"

# We have a recipes directory, add to BBFILES
BBFILES += "${LAYERDIR}/recipes*/*/*.bb ${LAYERDIR}/recipes*/*/*.bbappend"

BBFILE_COLLECTIONS += "meta-arduino-lmp"
BBFILE_PATTERN_meta-arduino-lmp := "^${LAYERDIR}/"
BBFILE_PRIORITY_meta-arduino-lmp = "9"

LAYERDEPENDS_meta-arduino-lmp = "core meta-lmp-bsp meta-arduino-common"
LAYERSERIES_COMPAT_meta-arduino-lmp = "kirkstone nanbield scarthgap"
```

## meta-arduino-lmp/conf/machine/include/lmp-partner-custom.inc
```bitbake
# LMP partner specific customizations (either replace or extend options as defined by meta-lmp)

EXTERNAL_KERNEL_DEVICETREE = "${DEPLOY_DIR_IMAGE}/devicetree"

IMAGE_BOOT_FILES:append:lmp-base = " ${DTB_BOOT_FILES}"

WKS_FILE:mx8mm-nxp-bsp:lmp:remove = "imx-imx-boot-singlepart.wks.in"
WKS_FILE:mx8mm-nxp-bsp:lmp:sota = "sdimage-imx8m-spl-sota.wks.in"

# Fix virtual/dtb provider for lmp builds
PREFERRED_PROVIDER:virtual/dtb:lmp ?= "lmp-device-tree"
PREFERRED_PROVIDER:virtual/dtb:lmp-base ?= "lmp-device-tree"

# Add se05x by default for production/secure builds
MACHINE_FEATURES:append:lmp = " se05x"
MACHINE_FEATURES:remove:lmp-base = " se05x"
MACHINE_FEATURES:remove:lmp-mfgtool = " se05x"
SE05X_OEFID = "0xA201"

# @TODO: current u-boot-fio breaks do_deploy without optee
#MACHINE_FEATURES:remove:lmp-base = " optee"
```

## meta-arduino-mp2/conf/machine/stm32mp25-cm4.conf
```bitbake
#@TYPE: Machine
#@NAME: Arduino STM32MP25-CM4
#@SOC: STM32MP25
#@DESCRIPTION: Machine configuration for Arduino STM32MP25-CM4 (STM32MP255FAL3, 1x16Gbit DDR4, 16GB eMMC & PAN WL602-B WiFi/BT)
#@MAINTAINER: Massimo Pennazio <m.pennazio@arduino.cc>

require conf/machine/stm32mp25-eval.conf

MACHINEOVERRIDES =. "stm32mp25-eval:"
```

## meta-arduino-nxp/conf/layer.conf
```bitbake
# We might have a conf and classes directory, append to BBPATH
BBPATH .= ":${LAYERDIR}"

# We have a recipes directory, add to BBFILES
BBFILES += "${LAYERDIR}/recipes*/*/*.bb ${LAYERDIR}/recipes*/*/*.bbappend"

BBFILE_COLLECTIONS += "meta-arduino-nxp"
BBFILE_PATTERN_meta-arduino-nxp := "^${LAYERDIR}/"
BBFILE_PRIORITY_meta-arduino-nxp = "9"

LAYERDEPENDS_meta-arduino-nxp = "core freescale-layer fsl-bsp-release fsl-sdk-release"
LAYERSERIES_COMPAT_meta-arduino-nxp = "kirkstone nanbield"
```

## meta-arduino-nxp/conf/machine/portenta-x8.conf
```bitbake
#@TYPE: Machine
#@NAME: Arduino Portenta-X8 i.MX8MM
#@SOC: i.MX8MM
#@DESCRIPTION: Machine configuration for Arduino Potenta-X8 (i.MX 8M Mini + STM32H7)
#@MAINTAINER: Massimo Pennazio <m.pennazio@arduino.cc>

require conf/machine/imx8mm-lpddr4-evk.conf

MACHINEOVERRIDES =. "mx8:mx8m:mx8mm:imx8mm-lpddr4-evk:"

# Override the variables you want to change here
IMX_DEFAULT_BSP = "nxp"
PREFERRED_PROVIDER:virtual/kernel = "linux-imx_6.6"
KBUILD_DEFCONFIG = ""

# Set KERNEL_DEVICETREE as empty since we are using a custom provider
#KERNEL_DEVICETREE = ""

# Since we are an override of imx8mm-lpddr4-evk, we need to adjust on top of what nxp bsp includes
KERNEL_DEVICETREE:remove = " \
    freescale/imx8mm-evk.dtb \
    freescale/imx8mm-evk-pcie-ep.dtb \
    freescale/imx8mm-evk-rm67191.dtb \
    freescale/imx8mm-evk-rm67191-cmd-ram.dtb \
    freescale/imx8mm-evk-rm67199.dtb \
    freescale/imx8mm-evk-rm67199-cmd-ram.dtb \
    freescale/imx8mm-evk-8mic-revE.dtb \
    freescale/imx8mm-evk-8mic-swpdm.dtb \
    freescale/imx8mm-evk-ak4497.dtb \
    freescale/imx8mm-evk-ak5558.dtb \
    freescale/imx8mm-evk-audio-tdm.dtb \
    freescale/imx8mm-evk-dpdk.dtb \
    freescale/imx8mm-evk-ecspi-slave.dtb \
    freescale/imx8mm-evk-lk.dtb \
    freescale/imx8mm-evk-inmate.dtb \
    freescale/imx8mm-evk-qca-wifi.dtb \
    freescale/imx8mm-evk-revb-qca-wifi.dtb \
    freescale/imx8mm-evk-root.dtb \
    freescale/imx8mm-evk-rpmsg.dtb \
    freescale/imx8mm-evk-rpmsg-wm8524.dtb \
    freescale/imx8mm-evk-rpmsg-wm8524-lpv.dtb \
    freescale/imx8mm-evk-usd-wifi.dtb \
"

PREFERRED_PROVIDER:virtual/dtb ?= "arduino-device-tree"

DTB_BOOT_FILES = " \
    devicetree/arduino_portenta-x8.dtb;arduino_portenta-x8.dtb \
    devicetree/*.dtbo;overlays/ \
"

IMAGE_BOOT_FILES:append:fsl-imx-xwayland = " ${DTB_BOOT_FILES}"

# Set machine features
#MACHINE_FEATURES = "usbgadget usbhost vfat alsa touchscreen screen wifi bluetooth optee rtc dpdk pci"

# Since we are an override of imx8mm-lpddr4-evk, we need to adjust on top of what nxp bsp provides
MACHINE_FEATURES:remove= " jailhouse bcm4359 bcm43455 bcm4356 nxp8987-sdio nxpwifi-all-sdio mxm-mwifiex-load"
MACHINE_FEATURES:append = " rtc"
MACHINE_FEATURES:append = " dpdk pci"

# Tweak machine features
MACHINE_FEATURES:remove = " \
    nxp8987-sdio \
    nxpwifi-all-sdio \
"

# Add additional firmware, mostly support for Murata 1DX WiFi / Bluetooth solution
MACHINE_FIRMWARE:append = " linux-firmware-cyw-fmac-fw linux-firmware-cyw-fmac-nvram linux-firmware-cyw-bt-patch"

# Added X8H7 solution based on ext. STM32 mcu
MACHINE_FIRMWARE:append = " linux-firmware-arduino-portenta-x8-stm32h7"

# Add custom video bridge and usb typec controller / power delivery solution
MACHINE_EXTRA_RRECOMMENDS += "anx7625"

# Add x8h7 driver for communication with external cortex processor via spi
MACHINE_EXTRA_RRECOMMENDS += "x8h7"

# Add extra kernel modules needed for Max carrier board
#MACHINE_EXTRA_RRECOMMENDS += "bq24195 cs42l52"

# Add mipi-csi cmos sensors drivers
#MACHINE_EXTRA_RRECOMMENDS += "ov5647-mipi imx219 imx477 imx708"

# Add mipi-dsi panels and touch screen controllers drivers
#MACHINE_EXTRA_RRECOMMENDS += "panel-sitronix-st7701 panel-jadard-ek79202d atmel-mxt-ts"

# Add neural external pcie modules drivers
MACHINE_EXTRA_RRECOMMENDS += "google-gasket-driver akida-pcie-driver hailo-pcie-driver"

# Module to load devicetree overlays at runtime in userspace
MACHINE_EXTRA_RRECOMMENDS:append = " dtbocfg"

# Portenta X8 has a Murata 1DX wifi/bt module which uses custom recipes
# linux-firmware-cyw-fmac-fw, linux-firmware-cyw-fmac-nvram and linux-firmware-cyw-bt-patch.
# Make sure we avoid default linux bcm43430 firmware
CORE_IMAGE_BASE_INSTALL:remove = " \
    linux-firmware-bcm43430 \
"

# Remove default linux-firmware and nxp-wifi firmware that are not needed
# and very big in size
CORE_IMAGE_BASE_INSTALL:remove = " \
    firmware-nxp-wifi \
    linux-firmware \
"

KERNEL_MODULE_AUTOLOAD:append = "anx7625 i2c-dev spidev"

# Custom wks file
WKS_FILE:mx8mm-nxp-bsp = "imx-imx-boot-singlepart.wks.in"

# @TODO: below seems to be ignored
SERIAL_CONSOLES = "115200;ttymxc2"

OSTREE_KERNEL_ARGS:portenta-x8 ?= "console=tty1 console=ttymxc2,115200 earlycon=ec_imx6q,0x30880000,115200 clk_ignore_unused ${OSTREE_KERNEL_ARGS_COMMON}"
```

## meta-arduino-nxp/conf/machine/portenta-x9.conf
```bitbake
#@TYPE: Machine
#@NAME: Arduino Portenta-X9 i.MX93
#@SOC: i.MX93
#@DESCRIPTION: Machine configuration for Arduino Potenta-X9 (i.MX93 11x11 with LPDDR4X)
#@MAINTAINER: Massimo Pennazio <m.pennazio@arduino.cc>

require conf/machine/imx93-11x11-lpddr4x-evk.conf

MACHINEOVERRIDES .= ":imx93-11x11-lpddr4x-evk"

# Override the variables you want to change here
IMX_DEFAULT_BSP = "nxp"
PREFERRED_PROVIDER:virtual/kernel = "linux-imx_6.6"
KBUILD_DEFCONFIG:portenta-x9 = ""
KERNEL_DEVICETREE = ""
KERNEL_DEVICETREE:remove:portenta-x9 = " freescale/imx93-11x11-evk-root.dtb"
PREFERRED_PROVIDER:virtual/dtb ?= "arduino-device-tree"

# Include custom device tree for linux kernel
MACHINE_EXTRA_RRECOMMENDS += "arduino-device-tree"

# Add additional out of tree modules
MACHINE_EXTRA_RRECOMMENDS += "kernel-module-nxp-wlan"

# Firmware NXP IW612 chipset
PREFERRED_RPROVIDER_linux-firmware-nxpiw612-sdio = "firmware-nxp-wifi"
MACHINE_EXTRA_RRECOMMENDS += "firmware-nxp-wifi-nxpiw612-sdio firmware-nxp-wifi"

# Additional specific packages
MACHINE_EXTRA_RRECOMMENDS += "lmbench"

# Custom wks file
WKS_FILE:mx9-nxp-bsp = "imx-imx-boot-singlepart.wks.in"

# @TODO: below seems to be ignored
SERIAL_CONSOLES = "115200;ttyLP5"
```

## meta-arduino-qcom/conf/bblayers.conf.sample
```bitbake
# POKY_BBLAYERS_CONF_VERSION is increased each time build/conf/bblayers.conf
# changes incompatibly
POKY_BBLAYERS_CONF_VERSION = "2"

BBPATH = "${TOPDIR}"
BBFILES ?= ""

BBLAYERS ?= " \
  /workdir/sources/openembedded-core/meta \
  /workdir/sources/openembedded-core/../meta-yocto/meta-poky \
  /workdir/sources/openembedded-core/../meta-yocto/meta-yocto-bsp \
  /workdir/sources/meta-openembedded/meta-oe \
  /workdir/sources/meta-openembedded/meta-python \
  /workdir/sources/meta-openembedded/meta-networking \
  /workdir/sources/meta-openembedded/meta-filesystems \
  /workdir/sources/meta-openembedded/meta-gnome \
  /workdir/sources/meta-openembedded/meta-multimedia \
  /workdir/sources/meta-openembedded/meta-xfce \
  /workdir/sources/meta-selinux \
  /workdir/sources/meta-security \
  /workdir/sources/meta-security/meta-tpm \
  /workdir/sources/meta-virtualization \
  /workdir/sources/meta-updater \
  /workdir/sources/meta-qcom \
  /workdir/sources/meta-qcom-distro \
  /workdir/sources/meta-qcom-3rdparty \
  /workdir/sources/meta-arduino/meta-arduino-common \
  /workdir/sources/meta-arduino/meta-arduino-qcom \
"
```

## meta-arduino-qcom/conf/machine/imola.conf
```bitbake
#@TYPE: Machine
#@NAME: Arduino Imola (RB1 Core Kit)
#@SOC: QRB2210
#@DESCRIPTION: Machine configuration for Arduino Imola based on Qualcomm Robotics RB1 Core Kit
#@MAINTAINER: Massimo Pennazio <maxipenna@libero.it>

require conf/machine/rb1-core-kit.conf

MACHINEOVERRIDES =. "rb1-core-kit:"

# Override the variables you want to change here
```
